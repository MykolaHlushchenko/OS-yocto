## build/conf/bblayers.conf
```bitbake
# POKY_BBLAYERS_CONF_VERSION is increased each time build/conf/bblayers.conf
# changes incompatibly
POKY_BBLAYERS_CONF_VERSION = "2"

BBPATH = "${TOPDIR}"
BBFILES ?= ""

BBLAYERS ?= " \
  /home/dell-5558/yokto/poky/meta \
  /home/dell-5558/yokto/poky/meta-poky \
  /home/dell-5558/yokto/poky/meta-yocto-bsp \
  /home/dell-5558/yokto/poky/meta-raspberrypi \
  /home/dell-5558/yokto/poky/meta-openembedded/meta-oe \
  /home/dell-5558/yokto/poky/meta-openembedded/meta-python \
  /home/dell-5558/yokto/poky/meta-openembedded/meta-networking \
  /home/dell-5558/yokto/poky/meta-openembedded/meta-filesystems \
  /home/dell-5558/yokto/poky/meta-virtualization \
  /home/dell-5558/yokto/poky/meta-lts-mixins \
  /home/dell-5558/yokto/poky/meta-ros/meta-ros-common \
  /home/dell-5558/yokto/poky/meta-ros/meta-ros2 \
  /home/dell-5558/yokto/poky/meta-ros/meta-ros2-humble \
  /home/dell-5558/yokto/poky/meta-myhlu-robot \
  "
```
